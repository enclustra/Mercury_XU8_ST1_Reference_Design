/include/ "system-conf.dtsi"
/ {
	model = "Enclustra ME-XU8-5EV-1I-D12E SOM";
};
#include "zynqmp_enclustra_common.dtsi"
#include "zynqmp_enclustra_mercury_xu8.dtsi"
#include "zynqmp_enclustra_mercury_st1.dtsi"
